#include "st7735.h"
#include "spi.h"          /* CubeMX 生成，含 extern hspi2 */
#include "FreeRTOS.h"
#include "task.h"         /* init 里用 vTaskDelay，必须在任务上下文调用 */

/* =========================================================================
 * 8x8 ASCII 字库（公有领域 font8x8，覆盖字符 32~95）
 * scale=1 时字符 8x8，scale=2 时 16x16
 * ========================================================================= */
static const uint8_t font8x8[64][8] = {
    {0x00,0x00,0x00,0x00,0x00,0x00,0x00,0x00}, /* ' ' */
    {0x18,0x3C,0x3C,0x18,0x18,0x00,0x18,0x00}, /* '!' */
    {0x36,0x36,0x00,0x00,0x00,0x00,0x00,0x00}, /* '"' */
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    {0x00,0x00,0x00,0x00,0x00,0x00,0xFF,0x00}, /* '_' */
};

/* ===================== 底层总线操作 ===================== */

static void wcmd(uint8_t c)
{
    LCD_CS_LOW();
    LCD_DC_LOW();                 /* DC=0 : 命令 */
    HAL_SPI_Transmit(&LCD_SPI_HANDLE, &c, 1, 100);
    LCD_CS_HIGH();
}

static void wbuf(const uint8_t *p, uint16_t n)
{
    LCD_CS_LOW();
    LCD_DC_HIGH();                /* DC=1 : 数据 */
    HAL_SPI_Transmit(&LCD_SPI_HANDLE, (uint8_t *)p, n, 100);
    LCD_CS_HIGH();
}

static void wdat(uint8_t d) { wbuf(&d, 1); }

static void wcmd_seq(uint8_t c, const uint8_t *p, uint16_t n)
{
    wcmd(c);
    wbuf(p, n);
}

/* ===================== 初始化 ===================== */

void ST7735_Init(void)
{
    static const uint8_t frm1   [3] = {0x01, 0x2C, 0x2D};
    static const uint8_t frm3   [6] = {0x01, 0x2C, 0x2D, 0x01, 0x2C, 0x2D};
    static const uint8_t invctr [1] = {0x07};
    static const uint8_t pwctr1 [3] = {0xA2, 0x02, 0x84};
    static const uint8_t pwctr2 [1] = {0xC5};
    static const uint8_t pwctr3 [2] = {0x0A, 0x00};
    static const uint8_t pwctr4 [2] = {0x8A, 0x2A};
    static const uint8_t pwctr5 [2] = {0x8A, 0xEE};
    static const uint8_t vmctr1 [1] = {0x0E};
    static const uint8_t gmctp [16] = {0x0F,0x1A,0x0F,0x18,0x2F,0x28,0x20,0x22,
                                       0x19,0x1F,0x78,0x36,0x00,0x08,0x03,0x0E};
    static const uint8_t gmctn [16] = {0x00,0x33,0x20,0x21,0x07,0x06,0x25,0x30,
                                       0x3F,0x3F,0x38,0x4D,0x3F,0x37,0x3C,0x00};

    LCD_BL_HIGH();                 /* 点背光 */
    LCD_CS_HIGH();

    /* 硬复位 */
    LCD_RST_LOW();  vTaskDelay(pdMS_TO_TICKS(20));
    LCD_RST_HIGH(); vTaskDelay(pdMS_TO_TICKS(120));

    wcmd(0x01);                                   /* SWRESET */
    vTaskDelay(pdMS_TO_TICKS(150));
    wcmd(0x11);                                   /* SLPOUT（退出睡眠） */
    vTaskDelay(pdMS_TO_TICKS(120));               /* 手册要求退出后必须等待 */

    wcmd_seq(0xB1, frm1,   3);      /* 帧率控制：正常模式 */
    wcmd_seq(0xB2, frm1,   3);      /*             空闲模式 */
    wcmd_seq(0xB3, frm3,   6);      /*             部分模式 */
    wcmd_seq(0xB4, invctr, 1);      /* 反转控制 */

    wcmd_seq(0xC0, pwctr1, 3);      /* 电源控制 1~5 */
    wcmd_seq(0xC1, pwctr2, 1);
    wcmd_seq(0xC2, pwctr3, 2);
    wcmd_seq(0xC3, pwctr4, 2);
    wcmd_seq(0xC4, pwctr5, 2);
    wcmd_seq(0xC5, vmctr1, 1);      /* VCOM 电压 */

#if ST7735_INVON
    wcmd(0x21);                    /* INVON */
#else
    wcmd(0x20);                    /* INVOFF */
#endif

    wcmd(0x36);                    /* MADCTL：扫描方向 + BGR */
    wdat(ST7735_MADCTL_INIT);

    wcmd(0x3A);                    /* COLMOD：16bit RGB565 */
    wdat(0x05);

    wcmd(0xE0); wbuf(gmctp, 16);    /* 伽马校正（正极性） */
    wcmd(0xE1); wbuf(gmctn, 16);    /* 伽马校正（负极性） */

    wcmd(0x13);                    /* NORON：正常显示模式 */
    vTaskDelay(pdMS_TO_TICKS(10));
    wcmd(0x29);                    /* DISPON：开显示 */
    vTaskDelay(pdMS_TO_TICKS(120));
}

/* ===================== 绘图区 =====================
 * 核心思路：RAMWR(0x2C) 之后可以连续往显存流像素，
 * 地址在窗口内自动递增 —— 所以画任何东西都是
 * "先 SetWindow 开窗口，再流像素" 两步。 */

static void ST7735_SetWindow(uint16_t x, uint16_t y, uint16_t w, uint16_t h)
{
    uint8_t d[4];
    uint16_t x0 = x + ST7735_XSTART, x1 = x + w - 1 + ST7735_XSTART;
    uint16_t y0 = y + ST7735_YSTART, y1 = y + h - 1 + ST7735_YSTART;

    if (w == 0 || h == 0) return;
    if (x + w > ST7735_WIDTH || y + h > ST7735_HEIGHT) return;  /* 越界保护 */

    wcmd(0x2A);                    /* CASET：列地址窗口 */
    d[0] = (uint8_t)(x0 >> 8); d[1] = (uint8_t)x0;
    d[2] = (uint8_t)(x1 >> 8); d[3] = (uint8_t)x1;
    wbuf(d, 4);

    wcmd(0x2B);                    /* RASET：行地址窗口 */
    d[0] = (uint8_t)(y0 >> 8); d[1] = (uint8_t)y0;
    d[2] = (uint8_t)(y1 >> 8); d[3] = (uint8_t)y1;
    wbuf(d, 4);

    wcmd(0x2C);                    /* RAMWR：进入写显存状态 */
}

void ST7735_FillRect(uint16_t x, uint16_t y, uint16_t w, uint16_t h, uint16_t color)
{
    uint8_t  chunk[64];            /* 一次推 32 像素，减少 HAL 调用次数 */
    uint32_t total;

    if (x >= ST7735_WIDTH || y >= ST7735_HEIGHT) return;
    if (x + w > ST7735_WIDTH)  w = ST7735_WIDTH  - x;   /* 裁剪到屏内 */
    if (y + h > ST7735_HEIGHT) h = ST7735_HEIGHT - y;
    if (w == 0 || h == 0) return;

    ST7735_SetWindow(x, y, w, h);
    total = (uint32_t)w * h;

    for (uint16_t i = 0; i < 32; i++) {
        chunk[2*i]     = (uint8_t)(color >> 8);   /* RGB565 高字节在前 */
        chunk[2*i + 1] = (uint8_t)color;
    }
    while (total >= 32) { wbuf(chunk, 64); total -= 32; }
    if (total) wbuf(chunk, total * 2);
}

void ST7735_FillScreen(uint16_t color)
{
    ST7735_FillRect(0, 0, ST7735_WIDTH, ST7735_HEIGHT, color);
}

void ST7735_DrawString(const char *s, uint16_t x, uint16_t y,
                       uint16_t fg, uint16_t bg, uint8_t scale)
{
    uint8_t fgp[2], bgp[2];
    uint16_t cw = (uint16_t)(8u * scale);

    fgp[0] = (uint8_t)(fg >> 8);  fgp[1] = (uint8_t)fg;
    bgp[0] = (uint8_t)(bg >> 8);  bgp[1] = (uint8_t)bg;

    while (*s && (uint16_t)(x + cw) <= ST7735_WIDTH)
    {
        char c = *s++;
        if (c < ' ' || c > '_') c = '?';          /* 字库只覆盖 32~95 */
        const uint8_t *glyph = font8x8[c - ' '];

        ST7735_SetWindow(x, y, cw, cw);           /* 每个字符开一次窗口 */
        LCD_CS_LOW();
        LCD_DC_HIGH();                            /* 整个字符期间不再拉高 CS */
        for (uint8_t row = 0; row < 8; row++)
        {
            uint8_t bits = glyph[row];
            for (uint8_t col = 0; col < 8; col++)
            {
                const uint8_t *px = (bits & (0x80u >> col)) ? fgp : bgp;
                for (uint8_t k = 0; k < scale; k++)
                    HAL_SPI_Transmit(&LCD_SPI_HANDLE, (uint8_t *)px, 2, 100);
            }
        }
        LCD_CS_HIGH();
        x += cw;
    }
}
